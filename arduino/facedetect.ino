#include <gfxfont.h>
#include <SPI.h>
#include <Wire.h>
#include <Servo.h>
#include <Adafruit_GFX.h>
#include <Adafruit_SSD1306.h>
#define OLED_RESET 4

Servo servoHorizontal;
Servo servoVertical;
int servoHorizontal_pos;
int servoVertical_pos;
int pin;
char command;
/*
 * COMMANDS: (H / V)
 * 
 * 0 - NONE, NONE
 * 1 - NONE, UP
 * 2 - NONE, DOWN
 * 3 - RIGHT, NONE
 * 4 - LEFT, NONE
 * 5 - RIGHT, UP
 * 6 - RIGHT, DOWN
 * 7 - LEFT, UP
 * 8 - LEFT, DOWN
 * 9 - NO FACE
 *
 * i - light green
 * o - light red
 * p - shut down
 */

Adafruit_SSD1306 display(OLED_RESET);
const unsigned char PROGMEM a[] = {0x0, 0x0, 0x0, 0x0, 0x0, 0x0, 0x0, 0x0, 0x0, 0x0, 0x0, 0x0, 0x0, 0x0, 0x0, 0x0, 
0x0, 0x0, 0x0, 0x0, 0x0, 0x0, 0x0, 0x0, 0x0, 0x0, 0x0, 0x0, 0x0, 0x0, 0x0, 0x0, 
0x0, 0x0, 0x0, 0x0, 0x0, 0x0, 0x0, 0x0, 0x0, 0x0, 0x0, 0x0, 0x0, 0x0, 0x0, 0x0, 
0x0, 0x0, 0x0, 0x0, 0x0, 0x0, 0x0, 0x0, 0x0, 0x0, 0x0, 0x0, 0x0, 0x0, 0x0, 0x0, 
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0x0, 0x0, 0x0, 0x0, 0x0, 0x0, 0x0, 0x0, 0x0, 0x0, 0x0, 0x0, 0x0, 0x0, 0x0, 0x0, 
0};
const unsigned char PROGMEM b[]{
  0x0, 0x0, 0x0, 0x0, 0x0, 0x0, 0x0, 0x0, 0x0, 0x0, 0x0, 0x0, 0x0, 0x0, 0x0, 0x0, 
0x0, 0x0, 0x0, 0x0, 0x0, 0x0, 0x0, 0x0, 0x0, 0x0, 0x0, 0x0, 0x0, 0x0, 0x0, 0x0, 
0x0, 0x0, 0x0, 0x0, 0x0, 0x0, 0x0, 0x0, 0x0, 0x0, 0x0, 0x0, 0x0, 0x0, 0x0, 0x0, 
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0x0, 0x0, 0x0, 0x0, 0x0, 0x0, 0x0, 0x0, 0x0, 0x0, 0x0, 0x0, 0x0, 0x0, 0x0, 0x0, 
0
};
const unsigned char PROGMEM c[]{
  0x0, 0x0, 0x0, 0x0, 0x0, 0x0, 0x0, 0x0, 0x0, 0x0, 0x0, 0x0, 0x0, 0x0, 0x0, 0x0, 
0x0, 0x0, 0x0, 0x0, 0x0, 0x0, 0x0, 0x0, 0x0, 0x0, 0x0, 0x0, 0x0, 0x0, 0x0, 0x0, 
0x0, 0x0, 0x0, 0x0, 0x0, 0x0, 0x0, 0x0, 0x0, 0x0, 0x0, 0x0, 0x0, 0x0, 0x0, 0x0, 
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0x0, 0x0, 0x0, 0x0, 0x0, 0x0, 0x0, 0x0, 0x0, 0x0, 0x0, 0x0, 0x0, 0x0, 0x0, 0x0, 
0
};
const unsigned char PROGMEM d[]{
  0x0, 0x0, 0x0, 0x0, 0x0, 0x0, 0x0, 0x0, 0x0, 0x0, 0x0, 0x0, 0x0, 0x0, 0x0, 0x0, 
0x0, 0x0, 0x0, 0x0, 0x0, 0x0, 0x0, 0x0, 0x0, 0x0, 0x0, 0x0, 0x0, 0x0, 0x0, 0x0, 
0x0, 0x0, 0x0, 0x0, 0x0, 0x0, 0x0, 0x0, 0x0, 0x0, 0x0, 0x0, 0x0, 0x0, 0x0, 0x0, 
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0x0, 0x0, 0x0, 0x0, 0x0, 0x0, 0x0, 0x0, 0x0, 0x0, 0x0, 0x0, 0x0, 0x0, 0x0, 0x0, 
};

void setup() //процедура setup
{
  display.begin(SSD1306_SWITCHCAPVCC, 0x3C); // initialize with the I2C addr 0x3D (for the 128x64)
  display.display();
  display.clearDisplay();
  display.drawBitmap(0, 0, a, 128, 64, WHITE); 
  display.display();
  display.clearDisplay();
  servoHorizontal.attach(9);
  servoVertical.attach(10);
  Serial.begin(9600);
  servoHorizontal_pos = 70;
  servoVertical_pos = 50;
  command = '0';
  servoVertical.write(servoVertical_pos);
  delay(100);
  servoHorizontal.write(servoHorizontal_pos);
  delay(100);

}

void turnUp()
{
  if (servoVertical_pos > 0)
  {
    display.drawBitmap(0, 0, a, 128, 64, WHITE); 
    display.display();
    display.clearDisplay();
    servoVertical.write(servoVertical_pos++);
    delay(100);
  }
}

void turnDown()
{
  if (servoVertical_pos < 180)
  {
    display.drawBitmap(0, 0, a, 128, 64, WHITE); 
    display.display();
    display.clearDisplay();
    servoVertical.write(servoVertical_pos--);
    delay(100);
  }
}

void turnLeft()
{
  if (servoHorizontal_pos > 0)
  {
    display.drawBitmap(0, 0, c, 128, 64, WHITE); 
    display.display();
    display.clearDisplay();
    servoHorizontal.write(servoHorizontal_pos--);
    delay(100);
  }
}

void turnRight()
{
  if (servoHorizontal_pos < 180)
  {
    display.drawBitmap(0, 0, b, 128, 64, WHITE); 
    display.display();
    display.clearDisplay();
    servoHorizontal.write(servoHorizontal_pos++);
    delay(100);
  }
}
void loop()
{ 
  if (Serial.available()>0)
  {
      command = Serial.read();
  }
  if (command == '0')
  {
    // NONE
  }
  else if (command == '1')
  {
    turnUp();
  }
  else if (command == '2')
  {
    turnDown();
  }
  else if (command == '3')
  {
    turnRight();
  }
  else if (command == '4')
  {
    turnLeft();
  }
  else if (command == '5')
  {
    turnRight();
    turnUp();
  }
  else if (command == '6')
  {
    turnRight();
    turnDown();
  }
  else if (command == '7')
  {
    turnLeft();
    turnUp();
  }
  else if (command == '8')
  {
    turnLeft();
    turnDown();
  }
  /*else if(command == '9')
  {
    display.drawBitmap(0, 0, d, 128, 64, WHITE); 
    display.display();
    display.clearDisplay();
  }*/
}
